## boards/arm/asc/Kconfig.board
```kconfig
# STM32F4DISCOVERY board configuration

# Copyright (c) 2016 Linaro Limited.
# SPDX-License-Identifier: Apache-2.0

config BOARD_ASC
	bool "Autonomous System Controller"
	depends on SOC_STM32F407XG
```

## boards/arm/asc/Kconfig.defconfig
```kconfig
# STM32F4DISCOVERY board configuration

# Copyright (c) 2016 Linaro Limited.
# SPDX-License-Identifier: Apache-2.0

if BOARD_ASC

config BOARD
	default "asc"

endif # BOARD_ASC
```
